## firmware/sdkconfig.defaults
```kconfig
# ESP32-S3 Target Configuration
CONFIG_IDF_TARGET="esp32s3"

# TinyUSB Configuration
CONFIG_TINYUSB=y
CONFIG_TINYUSB_HID_COUNT=1

# FreeRTOS 1000Hz tick rate for low input latency
CONFIG_FREERTOS_HZ=1000

# Wi-Fi buffer tuning
CONFIG_ESP_WIFI_STATIC_RX_BUFFER_NUM=16
CONFIG_ESP_WIFI_DYNAMIC_RX_BUFFER_NUM=32
CONFIG_ESP_WIFI_TX_BUFFER_TYPE=1
CONFIG_ESP_WIFI_DYNAMIC_TX_BUFFER_NUM=32
```
